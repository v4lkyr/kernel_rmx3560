## drivers/misc/mediatek/sensors-1.0/sensorHub/Kconfig
```kconfig
#
# CUSTOM_KERNEL_SENSORHUB is defined by
# drivers/misc/mediatek/sensor/2.0/mtk_nanohub/Kconfig, which is sourced
# before this file.  Keep only the legacy source list here.
#

#source "drivers/misc/mediatek/sensors-1.0/sensorHub/SCP_sensorHub/Kconfig"
#source "drivers/misc/mediatek/sensors-1.0/sensorHub/SCP_sensorHub_v1/Kconfig"
#source "drivers/misc/mediatek/sensors-1.0/sensorHub/SCP_shf/Kconfig"

source "drivers/misc/mediatek/sensors-1.0/sensorHub/nanohub/Kconfig"
```

## vendor/oplus/kernel/network/Kconfig
```kconfig
# SPDX-License-Identifier: GPL-2.0-only
# Copyright (C) 2018-2020 Oplus. All rights reserved.

source "net/oplus_modules/oplus_dns_hook/Kconfig"

source "net/oplus_modules/oplus_stats_calc/Kconfig"

source "net/oplus_modules/oplus_qr_scan/Kconfig"

source "net/oplus_modules/data_module/Kconfig"

source "net/oplus_modules/oplus_apps_monitor/Kconfig"

source "net/oplus_modules/oplus_network_tuning/Kconfig"

source "net/oplus_modules/oplus_score/Kconfig"

source "net/oplus_modules/oplus_game_first/Kconfig"

source "net/oplus_modules/oplus_socket_stats_report/Kconfig"
```

## vendor/oplus/kernel/network/oplus_game_first/Kconfig
```kconfig
config OPLUS_FEATURE_GAME_FIRST
    tristate "Game is always first"
    help
      Yeah.
```
