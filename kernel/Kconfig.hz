## kernel/Kconfig.hz
```kconfig
# SPDX-License-Identifier: GPL-2.0-only
#
# Timer Interrupt Frequency Configuration
#

config HZ
	int "Kernel HZ rate"
	default 100

config SCHED_HRTICK
	def_bool HIGH_RES_TIMERS
```
